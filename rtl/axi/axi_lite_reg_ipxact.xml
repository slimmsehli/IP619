# axi_lite_reg: IP-XACT component
VLNV my_company.com:reg_blocks:axi_lite_reg:1.0
16x8-bit AXI4-Lite Register Map with Permissions

## Bus interfaces (logical=physical port)
s_axi: slave amba.com:AMBA4:AXI4LE:r0p0, memory map s_axi_map
  AWADDR=awaddr, AWPROT=awprot, AWVALID=awvalid, AWREADY=awready, WDATA=wdata, WSTRB=wstrb, WVALID=wvalid, WREADY=wready, BRESP=bresp, BVALID=bvalid, BREADY=bready, ARADDR=araddr, ARPROT=arprot, ARVALID=arvalid, ARREADY=arready, RDATA=rdata, RRESP=rresp, RVALID=rvalid, RREADY=rready

## Address spaces and blocks
s_axi_map.reg_bank: base 0x00000000, range 0x00000040, width 32

## Registers
Registers are 32-bit, read-write, no defined reset value unless marked. A register's access mark holds for its fields unless they carry their own. Offsets are from the block's base; lines under a group give offsets from that group; [hi:lo] are bit positions; {n}, {i} and the like mark numbered series; 'fields as' and 'values as' point back to an identical list; <NAME> marks a mode.

## s_axi_map.reg_bank
Base 0x00000000
{0x0+4i} RW_REG[{i}] (i=0..7) — Standard Read/Write Registers
  [7:0] DATA
{0x20+4i} RO_STATUS_REG[{i}] (i=0..3) ro — Read-Only Status Registers
  [7:0] STATUS
{0x30+4i} PRIV_CTRL_REG[{i}] (i=0..3) — Privileged Configuration Registers (Requires AWPROT/ARPROT[0]=1)
  [7:0] CTRL
